/**
 Demo/Game sketch for TinyRFModulator and DisplayFoundation library project.
 ---------------------------------------------------------------------------
 This game was originally created by Maarten Janssen in 2015 and is converted to be able to use with TDisplayFoundation
 and TVOut. This is a demo project for TDisplayFoundation and TinyRFModulator.

 Serveral things are changed:
 - Reading controller values in percents
 - Added defines and macros, makes it easier to convert the code
 - Rebuild or remove graphics (monochrome)
 - Created some Keen artwork (monochrome)

  REQUIREMENTS
  - MCU with 32Kb program space
  - TVOut library
  - TV with RF input and TinyRFModulator
                OR
    TV with composite input
  - 10K Potentiometer as paddle input

  HOW TO CONNECT
  _____________
  ARDUINO      |
  NANO/    GND o-------------------------------\
  ATMEGA328    |                               _|_/|
           D11 o ------- SOUND OUT ------------[__ | SPEAKER
               |                                  \|                         RCA CONNECTOR
               |                                                             ____
           D9  o ------- VIDEO SYNC ----|__1K RESITOR ]--------- |              |______
               |                                                 |----TV--------|______)
           D7  o ------- VIDEO SIGNAL --|__470 OHM RESISTOR ] ---|          ____|
               |                                                              |
           GND o ---------------------------------------------------- TV-----/
               |                  _|_      |        _
                                  ___  1uF |_______| |_____
               |                   | +           --| |_____| 10K POTENTIOMETER LINEAIR
           AO  o ------------------|---------------|_|       (not a taper pot!)
               |
 ______________|

 TODO:
 - Auto alignment to any screensize


 * Maarten wrote:
 * Demo sketch for the LM15SGFNZ07 LCD display library.
 * The LM15SGFNZ07 is an LCD with a 101x80 pixels resolution, capable of displaying 4096 colors. It is found in Siemens
 * mobile phones (models A65, M55, C60, MC60, S55, A60).
 *
 * This demo lets you play the PaddleWar! game from the Commander
 * Keen series.
 *
 * Connect a potentionmeter to A0, +5v and GND to control your paddle. Simple sounds are provided if you
 * connect a small speaker between pins 11 and GND. The game will start automatically and end when either you or the
 * Arduino reach 21 points. Reset your Arduino for another game.
 * Coded by Maarten Janssen in 2015.

 * Latest version of the library can be downloaded from my GitHub page: http://github.com/DhrBaksteen
 *
 */

#include <TVout.h>
#include "DisplayFoundation.h"

TVout TV;

 // Size of TV screen in pixels.
 // ---------------------------
 // It is not guaranteed these settings will work with every TV out
 // there. If it doesn't work correctly, try different values. Keep
 // in mind it will fit available memory!
#define videoWidth() 100
#define videoHeight() 80 // Must be divisable by 8!

//#define videoWidth() 128
//#define videoHeight() 96 // Must be divisable by 8!

#define COLOR_FG 1
#define COLOR_BG 0

#define PIN_LCD_CS      9
#define PIN_LCD_RST     5
#define PIN_LCD_RS      4
#define PIN_SND_SPEAKER 7
#define PIN_CTRL_INPUT  A0 // Paddle ctrl, 10k pot
#define PIN_CTRL_MIN    16
#define PIN_CTRL_MAX    230
#define PIN_CTRL_SCALE  (PIN_CTRL_MAX-PIN_CTRL_MIN)
#define PIN_CTRL_INVERT true

#define VAL_POS_SIZE    12
#define VAL_POS_MIN     2
#define VAL_POS_MAX     (99-VAL_POS_SIZE)
#define VAL_POS_SCALE   (VAL_POS_MAX-VAL_POS_MIN)

#define VAL_PAD_WIDTH   (VAL_POS_SIZE+VAL_POS_MIN)
#define VAL_PAD_HEIGHT  3
#define VAL_PAD_POSY    71


#define PIN_LCD_LED1    3
#define PIN_LCD_LED2    6


 // Some conversion macro's
#define displayInit()  displayFoundry.onSetPixel = setFontPixelEventHandler;\
                 displayFoundry.setBG( DF_PIXEL_CLEAR );\
                       displayFoundry.begin( videoWidth(), videoHeight() );\
                       TV.begin(_PAL, videoWidth(), videoHeight());

#define displayClear(color) displayFoundry.clear(color)
#define displayDrawLine(x1,y1,x2,y2,color) displayFoundry.drawLine(x1,y1,x2,y2,color)
#define displayDrawBitmap(x,y,w,h,bmp) displayFoundry.drawBitmap(bmp,x,y,w,h)
#define displayDrawRect(x1,y1,x2,y2,color) displayFoundry.drawRect( x1,y1,x2,y2,color )
#define displayPrint(s,x,y,fg,bg) displayFoundry.gotoXY(x,y); displayFoundry.print(s)
#define displayFillRect(x,y,w,h,color) displayFoundry.drawFillRect(x,y,x+w,y+h,color)
#define displayDrawBall(x,y,h,w) displayFoundry.drawFillRect(x,y,x+2,y+2,1);\
                              displayFoundry.drawRect(x,y,x+4,y+4,0) // displayFoundry.drawCircle(x,y,4,4)
#define displayDrawPaddle(x,y,w,h) displayFoundry.drawFillRect(x,y,x+w,y+h-1)
#define displayGetFontWidth() displayFoundry.getFontWidth()
#define displayGetFontSpacing() displayFoundry.getCharSpacing()
#define tone(pin,freq,ms) TV.tone(freq,ms)
#define delay(n) TV.delay(n)

// ** bitmaps **

// image converted with use of https://javl.github.io/image2cpp/
const uint8_t bmpLogo[] PROGMEM =
{
  0x00, 0x00, 0x00, 0x00, 0x00, 0x00, 0x00, 0x00, 0x00, 0x00, 0xfe, 0x00, 0x00, 0x00, 0x00, 0x0c,
  0x0c, 0x00, 0x00, 0xc0, 0xff, 0x00, 0x00, 0x00, 0x00, 0x0c, 0x0c, 0x00, 0x00, 0xc0, 0xc3, 0x00,
  0x00, 0x00, 0x00, 0x0c, 0x0c, 0x00, 0x00, 0xc0, 0xc3, 0x00, 0x00, 0x00, 0x00, 0x0c, 0x0c, 0x00,
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  0xf0, 0x1f, 0x1e, 0x00, 0x00, 0x00, 0x00, 0x00, 0xff, 0xff, 0xe0, 0x3f, 0x3e, 0x00, 0x00, 0x00
};

// image converted with use of https://javl.github.io/image2cpp/
const uint8_t bmpPaddleWar[] PROGMEM =
{
  0xe3, 0x39, 0xc8, 0xe8, 0x4c, 0xe4, 0xf7, 0xad, 0x68, 0x88, 0x5e, 0xf4, 0x94, 0xa5, 0x28, 0x88,
  0x52, 0x94, 0x94, 0xa5, 0x28, 0xe8, 0x52, 0x94, 0xf7, 0xa5, 0x28, 0x8b, 0x5e, 0xf4, 0xe4, 0xa5,
  0x28, 0x8f, 0xd2, 0xc0, 0x84, 0xad, 0x68, 0x8c, 0xd2, 0xa4, 0x84, 0xb9, 0xce, 0xe8, 0x52, 0x94
};

// image converted with use of https://javl.github.io/image2cpp/
const uint8_t bmpWon[] PROGMEM =
{
0x00, 0x00, 0x00, 0x00, 0x00, 0x00, 0x00, 0x00, 0x00, 0x00, 0xc0, 0x00, 0x60, 0x00, 0x00, 0x00,
0x00, 0x00, 0x00, 0xc0, 0xc0, 0x00, 0x60, 0x00, 0x00, 0x00, 0x00, 0x00, 0x00, 0xc0, 0xc0, 0x00,
0x63, 0x00, 0x00, 0x00, 0x00, 0x00, 0x00, 0xc0, 0xc0, 0x00, 0x63, 0x00, 0x00, 0x00, 0x00, 0x00,
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0x00, 0x00, 0xff, 0x80, 0x00, 0x00, 0x00, 0x00, 0xff, 0xff, 0xc0, 0x07, 0xff, 0x80, 0x00, 0x00
};

// image converted with use of https://javl.github.io/image2cpp/
const uint8_t bmpLose[] PROGMEM =
{
0x00, 0x00, 0x00, 0x00, 0x00, 0x00, 0x00, 0x00, 0x00, 0x00, 0xfe, 0x00, 0x00, 0x00, 0x00, 0x00,
0x00, 0x00, 0x00, 0xc0, 0xff, 0x00, 0x00, 0x00, 0x00, 0x00, 0x00, 0x00, 0x00, 0xc0, 0xc3, 0x00,
0x00, 0x00, 0x00, 0x00, 0x00, 0x00, 0x00, 0xc0, 0xc3, 0x00, 0x00, 0x00, 0x00, 0x00, 0x00, 0x00,
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0xbf, 0xf0, 0xff, 0xfe, 0x20, 0x00, 0x00, 0x00, 0x00, 0x16, 0xaf, 0xef, 0xff, 0xf9, 0xe0, 0x00
};

// ** CODE STARTS HERE **

int paddleBottom;
float paddleTop;
int p1Score;
int p2Score;
int hold;
float ballX;
float ballY;
float ballDx;
float ballDy;


// Event handlers
uint8_t getFontPixelEventHandler( TDisplayFoundation* poSender,
                                  DFC_UINT_TYPE x,
                                  DFC_UINT_TYPE y )
{
   // Gets a pixel
  return TV.get_pixel( x,y );
}

void setFontPixelEventHandler( TDisplayFoundation* poSender,
                               DFC_UINT_TYPE x,
                               DFC_UINT_TYPE y,
                               uint8_t iSetMode )
{
   // Sets a pixel
  if( TV.get_pixel( x,y ) != iSetMode )
   { TV.set_pixel( x,y, iSetMode ); }
}

void gameReset()
{
 paddleBottom = 0;
 paddleTop = 43;
 p1Score = 0;
 p2Score = 0;
 hold = 0;
 ballX = 48;
 ballY = 42;
 ballDx = 0.5;
 ballDy = -0.5;
}

void displayScore()
{
  uint8_t iPosX = 88-((p2Score > 9)?(displayGetFontWidth()+displayGetFontSpacing()):0);
  displayFillRect(1, 2, 12, 7, COLOR_BG);
  displayFillRect(iPosX, 2, 12, 7, COLOR_BG);

  if( p1Score==0 )
   { displayPrint( "0", 2, 2, COLOR_FG, COLOR_BG); }
  else { displayPrint( p1Score, 2, 2, COLOR_FG, COLOR_BG); }


  if( p2Score==0 )
   { displayPrint( "0", iPosX ,2, COLOR_FG, COLOR_BG); }
  else { displayPrint( p2Score, iPosX, 2, COLOR_FG, COLOR_BG); }
  //88-((p2Score>9)?getFontWidth():0), 2, COLOR_FG, COLOR_BG);
}


void gameClear()
{
  //displayClear( COLOR_BG );
  displayFillRect( 0, 21, videoWidth(), 38, COLOR_FG );
  displayDrawBitmap( 13, 0, 74, 80, bmpLogo );
  delay(5000);

  gameReset();

  displayClear( COLOR_BG );
  displayDrawLine(0, 10, videoWidth(), 10, COLOR_FG);
  displayDrawLine(0, 75, videoWidth(), 75, COLOR_FG);
  //displayPrint("0", 2, 2, COLOR_FG, COLOR_BG);
  //displayPrint("0", 88, 2, COLOR_FG, COLOR_BG);
  //displayDrawBitmap(32, 1, 37, 8, bmpPaddleWar);
  displayDrawBitmap(27, 1, 46, 8, bmpPaddleWar);
  displayScore();

  ballDx = (random(2) - 0.5) / 2;
  ballDy = random(2) - 0.5;
  hold = 100;
}

/**
 * Check whether the paddle hits the ball and make it bounce off.
 */
void bouncePaddle(int paddleX)
{
  int collision = ballX - paddleX + 4;
  if (collision > 0 && collision < 16) {
    // If the ball is hit reverse Y direction and determine
    // X direction from where the ball hit the paddle
    ballDy = -ballDy;
    tone( PIN_SND_SPEAKER, 1200, 100);
    if (collision < 4) {
      ballDx = -0.5;
    } else if (collision < 8) {
      ballDx = -0.25;
    } else if (collision < 12) {
      ballDx = 0.25;
    } else {
      ballDx = 0.5;
    }
  }
}


/**
 * Either the player or the Arduino missed the ball.
 */
void miss()
{

  if( ballY <= 11 )
  {
     // Update player score. End game if 21.
    p1Score ++;

    tone( PIN_SND_SPEAKER , 600, 100);

    displayScore();

    if( p1Score == 21 )
     { gameEnd(true); }
  } else {
           // Update Arduino's score. End game if 21.
           p2Score ++;

           tone( PIN_SND_SPEAKER, 100, 500);

           displayScore();

           if (p2Score == 21)
            { gameEnd(false); }
         }

  // Set up next ball.
  ballY = 42;
  ballX = 48;
  ballDx = (random(2) - 0.5) / 2;
  hold = 100;
}


/**
 * Show win or lose message when game ends and stop.
 */
void gameEnd(bool bHasWon)
{

 /*
 for (int i = 1; i < 180; i += 2)
   { displayDrawLine(0, i, i, 0, COLOR_BG); }

  displayFillRect(20, 22, 60, 36, COLOR_BG);
  displayDrawRect(20, 22, 60, 36, COLOR_FG);
  //displayDrawBitmap(32, 25, 37, 8, bmpPaddleWar);
  displayDrawBitmap(27, 0, 46, 8, bmpPaddleWar);
  displayDrawLine(20, 35, 79, 35, COLOR_FG);

  if( bHasWon )
   { displayPrint("You won!", 34, 43, COLOR_FG, COLOR_BG); }
   else { displayPrint("You lose!", 32, 43, COLOR_FG, COLOR_BG); }
*/

  displayClear( COLOR_BG );
  displayFillRect( 0, 21, 100, 38, COLOR_FG );
  displayDrawBitmap( 13, 0, 74, 80, bHasWon?bmpWon:bmpLose );

   // Wait ten seconds
  delay( 10000 );

   // Reset game
  gameClear();
}

int getPaddleValPerc()
{
  int i = analogRead( PIN_CTRL_INPUT );

  if( i >= PIN_CTRL_MIN )
   {
      if( i >= PIN_CTRL_MAX )
       { i=PIN_CTRL_MAX; }

      i-=PIN_CTRL_MIN;
   }
  else { i=0; }

  if( i > 0 )
  {
     i = (uint8_t)round( i * (100.0 / (PIN_CTRL_SCALE)) );

     // allow only even values
     if( i > 0 && i % 2 != 0 )
      { ++i; }
  }

  #if defined( PIN_CTRL_INVERT )
   #if PIN_CTRL_INVERT == true
    return 100-i;
   #endif
  #endif

  return i;
}

int getPaddlePos()
{
  int i = VAL_POS_MIN+( getPaddleValPerc() * (100.0 / VAL_POS_SCALE ) );
  return i;
}

/**
 * Initialize LCD and PaddleWar game.
 */
void setup()
{
   // Serial setup
  Serial.begin(9600);

   // init the lcd
  displayInit();
  delay(1000);

   // Set backlight
  //pinMode( PIN_LCD_LED1  , OUTPUT );
  //pinMode( PIN_LCD_LED2  , OUTPUT );
  pinMode( PIN_CTRL_INPUT, INPUT_PULLUP );

   // Maximum brightness
  //analogWrite( PIN_LCD_LED1, 0xFF );
  //analogWrite( PIN_LCD_LED2, 0xFF );

   // Clear playfield and score
  gameClear();
}


/**
 * Main game loop.
 */
void loop()
{
  // Update player paddle position and remove old sprites.
  int newpaddleBottom = getPaddlePos();

  if (paddleBottom != newpaddleBottom)
  {
    displayFillRect(paddleBottom, VAL_PAD_POSY, VAL_PAD_WIDTH, VAL_PAD_HEIGHT, COLOR_BG );
    paddleBottom = newpaddleBottom;
  }

   // fillRect: x, y, w, h, c
  displayFillRect((int)paddleTop, 12, VAL_PAD_WIDTH, VAL_PAD_HEIGHT, COLOR_BG );
  displayFillRect((int)ballX, (int)ballY, 4, 4, COLOR_BG);

  if (hold == 0)
  {
    // Move Arduino's paddle.
    if (ballX < paddleTop + 5 && paddleTop > 0)
     { paddleTop -= 0.25; }
    else {
           if (ballX > paddleTop + 5 && paddleTop < 89)
            { paddleTop += 0.25; }
          }

    // Horizontal ball movement and bounce.
    ballX += ballDx;
    if (ballX >= 97)
    {
      ballX = 97;
      ballDx = -ballDx;
      tone( PIN_SND_SPEAKER, 1000, 100);
    }
    else {
           if (ballX <= 0)
            {
               ballX = 0;
               ballDx = -ballDx;
               tone( PIN_SND_SPEAKER, 1000, 100);
            }
         }

    // Vertical ball movement.
    ballY += ballDy;
    if (ballY > 68 && ballY < 71 && ballDy > 0)
    {
      // Bounce off player's paddle.
      bouncePaddle(paddleBottom);
    }
    else {
           if (ballY < 15 && ballY > 11 && ballDy < 0)
           {
             // Bounce off Arduino's paddle.
             bouncePaddle(paddleTop);
           } else {
                    if (ballY >= 71 || ballY <= 11)
                     {
                        // Player or Arduino missed the ball.
                        miss();
                     }
                  }
         }
  }
  else { hold --; }

  // Paint ball and paddles.
  if (hold == 0)
   { displayDrawBall((int)ballX, (int)ballY, 4, 4 ); }

  displayDrawPaddle((int)paddleTop, 12, 12, 3);
  displayDrawPaddle(paddleBottom, 71, 12, 3);

  delay(10);
}


